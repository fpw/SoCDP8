## src/yocto/meta-pynq-z2/conf/machine/pynq-z2.conf
```bitbake
#@TYPE: Machine
#@NAME: pynq-z2
#@DESCRIPTION: Machine support for Pynq-Z2.

SOC_FAMILY = "zynq"
SOC_VARIANT = "7z"

require conf/machine/include/tune-zynq.inc
require conf/machine/include/machine-xilinx-overrides.inc
require conf/machine/include/machine-xilinx-default.inc

MACHINE_FEATURES = "ext2 vfat usbhost"

# u-boot configuration
PREFERRED_PROVIDER_virtual/bootloader = "u-boot-xlnx"
UBOOT_MACHINE = "pynq_z2_config"
SPL_BINARY ?= "spl/boot.bin"
UBOOT_ELF_zynq = "u-boot"

EXTRA_IMAGEDEPENDS += " \
		pynq-z2-bitstream \
		u-boot-zynq-uenv \
		virtual/boot-bin \
		virtual/bootloader \
		"

SERIAL_CONSOLE = "115200 ttyPS0"

KERNEL_DEVICETREE = "zynq-pynqz2.dtb"
KERNEL_CLASSES += "kernel-fitimage"
KERNEL_IMAGETYPE = "fitImage"
KERNEL_IMAGETYPES = "fitImage"

IMAGE_BOOT_FILES += "pynq-z2.bit boot.bin uEnv.txt"
```

## src/yocto/meta-socdp8/conf/layer.conf
```bitbake
# We have a conf and classes directory, add to BBPATH
BBPATH .= ":${LAYERDIR}"

# We have recipes-* directories, add to BBFILES
BBFILES += "${LAYERDIR}/recipes-*/*/*.bb \
            ${LAYERDIR}/recipes-*/*/*.bbappend"

BBFILE_COLLECTIONS += "meta-socdp8"
BBFILE_PATTERN_meta-socdp8 = "^${LAYERDIR}/"
BBFILE_PRIORITY_meta-socdp8 = "6"

LAYERDEPENDS_meta-socdp8 = "core xilinx"
LAYERSERIES_COMPAT_meta-socdp8 = "warrior"
```

## src/yocto/meta-zynqberry/conf/layer.conf
```bitbake
# We have a conf and classes directory, add to BBPATH
BBPATH .= ":${LAYERDIR}"

# We have recipes-* directories, add to BBFILES
BBFILES += "${LAYERDIR}/recipes-*/*/*.bb \
            ${LAYERDIR}/recipes-*/*/*.bbappend"

BBFILE_COLLECTIONS += "meta-zynqberry"
BBFILE_PATTERN_meta-zynqberry = "^${LAYERDIR}/"
BBFILE_PRIORITY_meta-zynqberry = "6"

LAYERDEPENDS_meta-zynqberry = "core"
LAYERSERIES_COMPAT_meta-zynqberry = "zeus"
```

## yocto/meta-pynq-z2/conf/layer.conf
```bitbake
# We have a conf and classes directory, add to BBPATH
BBPATH .= ":${LAYERDIR}"

# We have recipes-* directories, add to BBFILES
BBFILES += "${LAYERDIR}/recipes-*/*/*.bb \
            ${LAYERDIR}/recipes-*/*/*.bbappend"

BBFILE_COLLECTIONS += "meta-pynq-z2"
BBFILE_PATTERN_meta-pynq-z2 = "^${LAYERDIR}/"
BBFILE_PRIORITY_meta-pynq-z2 = "6"

LAYERDEPENDS_meta-pynq-z2 = "core"
LAYERSERIES_COMPAT_meta-pynq-z2 = "warrior"
```
